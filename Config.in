## Config.in
```kconfig
source "$BR2_EXTERNAL_TPMDD_PATH/package/libtpms/Config.in"
source "$BR2_EXTERNAL_TPMDD_PATH/package/swtpm/Config.host.in"
```

## configs/tpmdd_qemu_x86_64_defconfig
```kconfig
BR2_x86_64=y
BR2_PACKAGE_GLIBC_UTILS=y
BR2_CCACHE=y
BR2_CCACHE_DIR="$(BASE_DIR)/ccache"
BR2_SYSTEM_DHCP="eth0"
BR2_ROOTFS_OVERLAY="$(BR2_EXTERNAL_TPMDD_PATH)/board/tpmdd_qemu_x86_64/rootfs-overlay"
BR2_ROOTFS_POST_BUILD_SCRIPT="$(BR2_EXTERNAL_TPMDD_PATH)/board/tpmdd_qemu_x86_64/post-build.sh"
BR2_ROOTFS_POST_IMAGE_SCRIPT="$(BR2_EXTERNAL_TPMDD_PATH)/board/tpmdd_qemu_x86_64/post-image.sh"
BR2_ROOTFS_POST_SCRIPT_ARGS="$(BR2_DEFCONFIG)"
BR2_LINUX_KERNEL=y
BR2_LINUX_KERNEL_CUSTOM_GIT=y
BR2_LINUX_KERNEL_CUSTOM_REPO_URL="https://git.kernel.org/pub/scm/linux/kernel/git/jarkko/linux-tpmdd.git"
BR2_LINUX_KERNEL_CUSTOM_REPO_VERSION="next"
BR2_LINUX_KERNEL_USE_CUSTOM_CONFIG=y
BR2_LINUX_KERNEL_CUSTOM_CONFIG_FILE="$(BR2_EXTERNAL_TPMDD_PATH)/board/tpmdd_qemu_x86_64/linux.config"
BR2_LINUX_KERNEL_NEEDS_HOST_LIBELF=y
BR2_PACKAGE_LINUX_TOOLS_SELFTESTS=y
BR2_PACKAGE_BUSYBOX_SHOW_OTHERS=y
BR2_PACKAGE_GIT=y
BR2_PACKAGE_MAKE=y
BR2_PACKAGE_PYTHON3=y
BR2_PACKAGE_CA_CERTIFICATES=y
BR2_PACKAGE_LIBCURL=y
BR2_PACKAGE_DROPBEAR=y
BR2_PACKAGE_LRZSZ=y
BR2_PACKAGE_FILE=y
BR2_PACKAGE_KEYUTILS=y
BR2_PACKAGE_UTIL_LINUX_BINARIES=y
BR2_TARGET_ROOTFS_EXT2=y
BR2_TARGET_ROOTFS_EXT2_SIZE="128M"
BR2_PACKAGE_HOST_QEMU_SYSTEM_MODE=y
BR2_PACKAGE_HOST_SWTPM=y
```

## package/libtpms/Config.in
```kconfig
config BR2_PACKAGE_LIBTPMS
	bool "libtpms"
        depends on BR2_USE_WCHAR # glib2
        depends on BR2_TOOLCHAIN_HAS_THREADS # glib2
        depends on BR2_USE_MMU # glib2
	help
	  TPM emulation library

	  https://github.com/stefanberger/libtpms
```
